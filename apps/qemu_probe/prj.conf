## CMakeLists.txt
```
# SPDX-License-Identifier: Apache-2.0
cmake_minimum_required(VERSION 3.20.0)
list(APPEND ZEPHYR_EXTRA_MODULES "${CMAKE_CURRENT_SOURCE_DIR}/../..")
find_package(Zephyr REQUIRED HINTS $ENV{ZEPHYR_BASE})
project(qemu_probe)
target_sources(app PRIVATE src/main.c)
```

## prj.conf
```kconfig
CONFIG_ARM64_EL2=y
CONFIG_ARMV8_A_NS=y
CONFIG_FPU=y
CONFIG_FPU_SHARING=y
CONFIG_PICOLIBC=y
CONFIG_COMMON_LIBC_MALLOC_ARENA_SIZE=8388608
CONFIG_MAIN_STACK_SIZE=65536
CONFIG_HEAP_MEM_POOL_SIZE=1048576
CONFIG_QEMU=y
CONFIG_QEMU_PL011_PROBE=y
CONFIG_ASSERT=y
CONFIG_POSIX_THREADS=y
CONFIG_POSIX_THREAD_THREADS_MAX=8
CONFIG_POSIX_API=y
```

## app.overlay
```dts
&{/psci} {
    method = "smc";
};
```

## src/main.c
```c
/*
 * SPDX-FileCopyrightText: Copyright The Zephyr Project Contributors
 * SPDX-License-Identifier: Apache-2.0
 */
#include <zephyr/kernel.h>
#include <qemu/zephyr.h>

int main(void)
{
    uint64_t current_el;
    int result;

    __asm__ volatile("mrs %0, CurrentEL" : "=r"(current_el));
    printk("QEMU Zephyr host EL%llu\n", current_el >> 2);
    if (current_el != 8U) {
        return -1;
    }
    result = qemu_zephyr_pl011_probe();
    printk("QEMU probe result=%d\n", result);
    return result;
}
```
