## src/zephyr/arch/arm64/core/hypervisor/Kconfig
```kconfig
# SPDX-FileCopyrightText: Copyright The Zephyr Project Contributors
# SPDX-License-Identifier: Apache-2.0

menuconfig ARM64_HYPERVISOR
	bool "Native AArch64 guest executor"
	depends on ARM64_EL2 && ARM_MMU && GIC_V3 && FPU_SHARING
	help
	  Execute one AArch64 guest with Stage-2 isolation. Devices and
	  instruction exits are handled by an external device model.

if ARM64_HYPERVISOR

config ARM64_HYPERVISOR_RAM_SIZE_MIB
	int "Reserved guest RAM size in MiB"
	default 256
	range 2 3072
	help
	  Statically reserve a contiguous area aligned to 2 MiB. The size must
	  be even and the board must provide enough RAM for both host and guest.

config ARM64_HYPERVISOR_IPA_BITS
	int "Guest physical address width"
	default 32
	range 32 36
	help
	  Increase the guest physical address range when a memory-mapped image
	  lives above the guest's main RAM. Stage-2 tables cover this range.

config ARM64_HYPERVISOR_GIC_LR_IRQS
	bool "Use GIC List Registers for virtual interrupt lines"
	help
	  Signal the external device model's IRQ and FIQ lines with two GIC
	  virtual List Registers. CPU-interface accesses remain trapped, so
	  interrupt acknowledgement and priority belong to the device model.
	  Supports nested hypervisors that do not implement HCR VI/VF injection.

endif # ARM64_HYPERVISOR
```

## west/west.yml
```yaml
# SPDX-License-Identifier: Apache-2.0
manifest:
  version: "1.2"
  projects:
    - name: qemu
      url: https://github.com/qemu/qemu.git
      revision: 1df256f5968e9f7c3c4533a1383b071c044a36d6
      path: upstream/qemu
      clone-depth: 1
    - name: zephyr
      url: https://github.com/zephyrproject-rtos/zephyr.git
      revision: ba25413e5b6b2661a71db24888f6b89274f1480d
      path: upstream/zephyr
      clone-depth: 1
      west-commands: scripts/west-commands.yml
    - name: dtc
      url: https://gitlab.com/qemu-project/dtc.git
      revision: b6910bec11614980a21e46fbccc35934b671bd81
      path: upstream/dtc
      clone-depth: 1
    - name: zlib
      url: https://github.com/madler/zlib.git
      revision: 51b7f2abdade71cd9bb0e7a373ef2610ec6f9daf
      path: upstream/zlib
      clone-depth: 1
  self:
    path: .
```

## zephyr/Kconfig
```kconfig
# SPDX-License-Identifier: GPL-2.0-or-later

menuconfig QEMU
	bool "QEMU emulation subsystem"
	depends on ARM64
	select REQUIRES_FULL_LIBC
	select STATIC_INIT_GNU
	select THREAD_LOCAL_STORAGE
	help
	  Build QEMU object, device and memory models for native execution
	  hosted by Zephyr. The initial platform has one ARM64 virtual CPU.

if QEMU

config QEMU_SYSTEM
	bool
	default y if QEMU_ZEPHYR_ACCEL || (QEMU_TCG && !QEMU_USER)

config QEMU_USER
	bool "AArch64 Linux user emulation"
	depends on QEMU_TCG
	help
	  Execute Linux ELF programs with TCG and translate their system calls
	  to Zephyr. Each program has a bounded private address space.

config QEMU_USER_MEMORY_MIB
	int "Linux process address space in MiB"
	default 64
	range 16 128
	depends on QEMU_USER

config QEMU_ZEPHYR_ACCEL
	bool "Native ARM64 virtualization accelerator"
	depends on ARM64_HYPERVISOR && !SMP
	help
	  Run a single ARM64 virtual CPU with the Zephyr EL2 executor and
	  QEMU's ARM CPU, interrupt controller and Linux boot models.

config QEMU_TCG
	bool "TCG software translation accelerator"
	depends on !QEMU_ZEPHYR_ACCEL && !SMP && ARM_MMU
	help
	  Run an AArch64 guest through QEMU's TCG translator and software
	  MMU. The Zephyr host does not need hardware virtualization.

config QEMU_MACHINE_MODEL
	string "Guest QEMU machine model"
	default "zephyr-virt"
	depends on QEMU_SYSTEM
	help
	  QEMU machine selected before realization. The supported machine is
	  zephyr-virt, with one ARM64 CPU, PL011 and a software GICv3.

config QEMU_SHELL
	bool "Start QEMU from the Zephyr shell"
	depends on (QEMU_SYSTEM || QEMU_USER) && SHELL && FILE_SYSTEM
	help
	  Provide qemu-system-aarch64 with image paths and guest configuration.
	  The shell owns UART input and forwards it while the guest is running.

config QEMU_EMBEDDED_PAYLOAD
	bool "Expose built-in Linux and initramfs files under /guest"
	depends on QEMU_SYSTEM
	default y if !QEMU_SHELL && !QEMU_NATIVE_PROBE_ONLY

config QEMU_AUTOSTART
	bool "Execute a QEMU command automatically after boot"
	depends on QEMU_SHELL

config QEMU_STARTUP_COMMAND
	string "Automatic QEMU shell command"
	depends on QEMU_AUTOSTART
	default "qemu-system-aarch64 -kernel /images/Image -initrd /images/initramfs.cpio.gz"

config QEMU_CPU_MODEL
	string "Guest ARM64 CPU model"
	default "cortex-a53"
	depends on QEMU_SYSTEM || QEMU_USER
	help
	  QEMU CPU model selected before machine realization. The native
	  accelerator requires a supported model matching the host CPU.

config QEMU_FRAMEBUFFER
	bool "Linux simple framebuffer on the Zephyr display"
	depends on QEMU_SYSTEM && DISPLAY
	help
	  Reserve the last 4 MiB of guest RAM for a simple-framebuffer device
	  and copy its pixels to the chosen Zephyr display at 10 frames/second.
	  The display must use ARGB8888 and fit within the reserved memory.

config QEMU_TCG_CACHE_SIZE_MIB
	int "TCG code cache size in MiB"
	default 16
	range 2 64
	depends on QEMU_TCG

config QEMU_NATIVE_PROBE_ONLY
	bool "Stop after the native CPU and PL011 integration probe"
	depends on QEMU_ZEPHYR_ACCEL
	help
	  Exercise the native accelerator and real QEMU device models without
	  mounting or starting a Linux image. This is an intermediate diagnostic.

config QEMU_HOST_HEARTBEAT
	bool "Track independent host-thread scheduling"
	depends on QEMU_SYSTEM
	help
	  The Linux test application starts a higher-priority Zephyr thread
	  which maintains scheduling counters while the virtual CPU is running.
	  The shell exposes these counters through qemu-system-aarch64 -status.

config QEMU_PL011_PROBE
	bool "PL011 object and memory dispatch probe"
	help
	  Exercise the real QEMU PL011 model through QOM, qdev and its
	  MemoryRegion register interface before starting a virtual CPU.

endif
```
